## embedded/esp32/heatlink/esp32s3/main/Kconfig.projbuild
```kconfig
menu "Nakostat heatlink"

config HEATLINK_LED_LEVEL
    int "Status LED brightness (0-255)"
    range 0 255
    default 40

config HEATLINK_OTA_DOWNLOAD_DEADLINE_S
    int "Longest an update's download may take (seconds)"
    default 300
    range 10 900
    help
        A download that takes longer than this is abandoned and backed off. A 1 MB image takes
        well under a minute. Lower only to test it.

endmenu
```
